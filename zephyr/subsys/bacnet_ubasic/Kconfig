## zephyr/subsys/bacnet_ubasic/Kconfig
```kconfig
# Kconfig - uBASIC+BACnet Program object subsystem configuration options
#
# @date 2026
# @copyright SPDX-License-Identifier: Apache-2.0

menuconfig BACNETSTACK_BACNET_UBASIC
    bool "BACnet uBASIC scripting (Program object)"
    depends on BACNET_BASIC_OBJECT_PROGRAM && BACNET_BASIC_OBJECT_FILE
    default n
    help
      Enables the uBASIC+BACnet scripting engine, wired to BACnet Program
      objects (state/lifecycle) and File objects (script source storage),
      ported from bacnet-stack's ports/stm32f4xx reference implementation.

if BACNETSTACK_BACNET_UBASIC

    module = BACNETSTACK_BACNET_UBASIC
    module-str = bacnet_ubasic

    config BACNETSTACK_UBASIC_TASK_INTERVAL_MS
        int "uBASIC program task tick interval in milliseconds"
        default 10
        help
          How often each running uBASIC program's Program_Timer() gets
          called, independent of and in addition to the generic ~100ms
          BACnet object housekeeping tick - scripts using sleep()/tic()/
          toc() want a finer-grained tick than generic object polling.

    config BACNETSTACK_UBASIC_SCRIPT_BUFFER_SIZE
        int "Max uBASIC script size in bytes, per Program instance"
        default 512
        help
          Size of the private scratch buffer each Program instance copies
          its linked File object's live content into on Load/Restart. A
          larger File write than this is ignored (falls back to the
          bootstrap script) rather than read partially/truncated.

endif # BACNETSTACK_BACNET_UBASIC
```
